;*****************************************************************************************************************
;EJERCICIO_2.asm; LED intermitente optimizado
;*****************************************************************************************************************
	LIST P=16F887;
;*****************************************************************************************************************
; Registros y constantes propios del micro
	INCLUDE "P16F887.INC"
;*****************************************************************************************************************
;*****************************************************************************************************************
; Registros particulares del programa
CONT1	EQU	20;
CONT2	EQU	21;
;*****************************************************************************************************************
; Constantes
KTE1	EQU	2;
KTE2	EQU	2;
;*****************************************************************************************************************
; AsignaciСn de puertos
P_LED	EQU	PORTA;
B_LED	EQU	0;
;*****************************************************************************************************************
;*****************************************************************************************************************
; Inicio de programa. DirecciСn de Reset
;*****************************************************************************************************************
;*****************************************************************************************************************
	ORG	003;
	GOTO	PROGPPAL;
;*****************************************************************************************************************
; Programa principal
;*****************************************************************************************************************
PROGPPAL:
;****** Inicializaciones
	CALL	INITPA;
;******	Lazo principal
LAZOPPAL:
	BCF	P_LED,B_LED;
	MOVLW	KTE1;
	CALL	ESPERA;
	MOVWF	CONT1;
	BSF	P_LED,B_LED;
	MOVLW	KTE1;
	CALL	ESPERA;
	GOTO	LAZOPPAL;
	
;*****************************************************************************************************************
;*****************************************************************************************************************
;****** Subrutinas
;*****************************************************************************************************************
;*****************************************************************************************************************
; ESPERA 	
; Recibe: W=Multiplicador de tiempo de espera;
ESPERA:
	MOVWF	CONT1;
PAUS11:
	MOVLW	0FF;
	MOVWF	CONT2;
PAUS12:
	DECFSZ	CONT2,F;
	GOTO	PAUS12;
	DECFSZ	CONT1,F;
	GOTO	PAUS11;
	RETURN;



;*****************************************************************************************************************
; INITPA
;******	Inicializaciones
INITPA:
	BSF	STATUS,RP0;
	BSF	STATUS,RP1;
	CLRF	ANSEL&7F;
	CLRF	ANSELH&7F;
	BCF	STATUS,RP1;
	CLRF	P_LED;
	BCF	STATUS,RP0;
	RETURN;	
;*****************************************************************************************************************
	END;